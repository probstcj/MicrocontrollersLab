/*******************************************************************************
* File Name: cyfittergnu.inc
* 
* PSoC Creator  4.2
*
* Description:
* 
* This file is automatically generated by PSoC Creator.
*
********************************************************************************
* Copyright (c) 2007-2018 Cypress Semiconductor.  All rights reserved.
* You may use this file only in accordance with the license, terms, conditions, 
* disclaimers, and limitations in the end user license agreement accompanying 
* the software package with which this file was provided.
********************************************************************************/

.ifndef INCLUDED_CYFITTERGNU_INC
.set INCLUDED_CYFITTERGNU_INC, 1
.include "cydevicegnu_trm.inc"

/* C0 */
.set C0__0__DR, CYREG_GPIO_PRT1_DR
.set C0__0__DR_CLR, CYREG_GPIO_PRT1_DR_CLR
.set C0__0__DR_INV, CYREG_GPIO_PRT1_DR_INV
.set C0__0__DR_SET, CYREG_GPIO_PRT1_DR_SET
.set C0__0__HSIOM, CYREG_HSIOM_PORT_SEL1
.set C0__0__HSIOM_MASK, 0x00000F00
.set C0__0__HSIOM_SHIFT, 8
.set C0__0__INTCFG, CYREG_GPIO_PRT1_INTR_CFG
.set C0__0__INTR, CYREG_GPIO_PRT1_INTR
.set C0__0__INTR_CFG, CYREG_GPIO_PRT1_INTR_CFG
.set C0__0__INTSTAT, CYREG_GPIO_PRT1_INTR
.set C0__0__MASK, 0x04
.set C0__0__PA__CFG0, CYREG_UDB_PA1_CFG0
.set C0__0__PA__CFG1, CYREG_UDB_PA1_CFG1
.set C0__0__PA__CFG10, CYREG_UDB_PA1_CFG10
.set C0__0__PA__CFG11, CYREG_UDB_PA1_CFG11
.set C0__0__PA__CFG12, CYREG_UDB_PA1_CFG12
.set C0__0__PA__CFG13, CYREG_UDB_PA1_CFG13
.set C0__0__PA__CFG14, CYREG_UDB_PA1_CFG14
.set C0__0__PA__CFG2, CYREG_UDB_PA1_CFG2
.set C0__0__PA__CFG3, CYREG_UDB_PA1_CFG3
.set C0__0__PA__CFG4, CYREG_UDB_PA1_CFG4
.set C0__0__PA__CFG5, CYREG_UDB_PA1_CFG5
.set C0__0__PA__CFG6, CYREG_UDB_PA1_CFG6
.set C0__0__PA__CFG7, CYREG_UDB_PA1_CFG7
.set C0__0__PA__CFG8, CYREG_UDB_PA1_CFG8
.set C0__0__PA__CFG9, CYREG_UDB_PA1_CFG9
.set C0__0__PC, CYREG_GPIO_PRT1_PC
.set C0__0__PC2, CYREG_GPIO_PRT1_PC2
.set C0__0__PORT, 1
.set C0__0__PS, CYREG_GPIO_PRT1_PS
.set C0__0__SHIFT, 2
.set C0__DR, CYREG_GPIO_PRT1_DR
.set C0__DR_CLR, CYREG_GPIO_PRT1_DR_CLR
.set C0__DR_INV, CYREG_GPIO_PRT1_DR_INV
.set C0__DR_SET, CYREG_GPIO_PRT1_DR_SET
.set C0__INTCFG, CYREG_GPIO_PRT1_INTR_CFG
.set C0__INTR, CYREG_GPIO_PRT1_INTR
.set C0__INTR_CFG, CYREG_GPIO_PRT1_INTR_CFG
.set C0__INTSTAT, CYREG_GPIO_PRT1_INTR
.set C0__MASK, 0x04
.set C0__PA__CFG0, CYREG_UDB_PA1_CFG0
.set C0__PA__CFG1, CYREG_UDB_PA1_CFG1
.set C0__PA__CFG10, CYREG_UDB_PA1_CFG10
.set C0__PA__CFG11, CYREG_UDB_PA1_CFG11
.set C0__PA__CFG12, CYREG_UDB_PA1_CFG12
.set C0__PA__CFG13, CYREG_UDB_PA1_CFG13
.set C0__PA__CFG14, CYREG_UDB_PA1_CFG14
.set C0__PA__CFG2, CYREG_UDB_PA1_CFG2
.set C0__PA__CFG3, CYREG_UDB_PA1_CFG3
.set C0__PA__CFG4, CYREG_UDB_PA1_CFG4
.set C0__PA__CFG5, CYREG_UDB_PA1_CFG5
.set C0__PA__CFG6, CYREG_UDB_PA1_CFG6
.set C0__PA__CFG7, CYREG_UDB_PA1_CFG7
.set C0__PA__CFG8, CYREG_UDB_PA1_CFG8
.set C0__PA__CFG9, CYREG_UDB_PA1_CFG9
.set C0__PC, CYREG_GPIO_PRT1_PC
.set C0__PC2, CYREG_GPIO_PRT1_PC2
.set C0__PORT, 1
.set C0__PS, CYREG_GPIO_PRT1_PS
.set C0__SHIFT, 2

/* C1 */
.set C1__0__DR, CYREG_GPIO_PRT1_DR
.set C1__0__DR_CLR, CYREG_GPIO_PRT1_DR_CLR
.set C1__0__DR_INV, CYREG_GPIO_PRT1_DR_INV
.set C1__0__DR_SET, CYREG_GPIO_PRT1_DR_SET
.set C1__0__HSIOM, CYREG_HSIOM_PORT_SEL1
.set C1__0__HSIOM_MASK, 0x0000F000
.set C1__0__HSIOM_SHIFT, 12
.set C1__0__INTCFG, CYREG_GPIO_PRT1_INTR_CFG
.set C1__0__INTR, CYREG_GPIO_PRT1_INTR
.set C1__0__INTR_CFG, CYREG_GPIO_PRT1_INTR_CFG
.set C1__0__INTSTAT, CYREG_GPIO_PRT1_INTR
.set C1__0__MASK, 0x08
.set C1__0__PA__CFG0, CYREG_UDB_PA1_CFG0
.set C1__0__PA__CFG1, CYREG_UDB_PA1_CFG1
.set C1__0__PA__CFG10, CYREG_UDB_PA1_CFG10
.set C1__0__PA__CFG11, CYREG_UDB_PA1_CFG11
.set C1__0__PA__CFG12, CYREG_UDB_PA1_CFG12
.set C1__0__PA__CFG13, CYREG_UDB_PA1_CFG13
.set C1__0__PA__CFG14, CYREG_UDB_PA1_CFG14
.set C1__0__PA__CFG2, CYREG_UDB_PA1_CFG2
.set C1__0__PA__CFG3, CYREG_UDB_PA1_CFG3
.set C1__0__PA__CFG4, CYREG_UDB_PA1_CFG4
.set C1__0__PA__CFG5, CYREG_UDB_PA1_CFG5
.set C1__0__PA__CFG6, CYREG_UDB_PA1_CFG6
.set C1__0__PA__CFG7, CYREG_UDB_PA1_CFG7
.set C1__0__PA__CFG8, CYREG_UDB_PA1_CFG8
.set C1__0__PA__CFG9, CYREG_UDB_PA1_CFG9
.set C1__0__PC, CYREG_GPIO_PRT1_PC
.set C1__0__PC2, CYREG_GPIO_PRT1_PC2
.set C1__0__PORT, 1
.set C1__0__PS, CYREG_GPIO_PRT1_PS
.set C1__0__SHIFT, 3
.set C1__DR, CYREG_GPIO_PRT1_DR
.set C1__DR_CLR, CYREG_GPIO_PRT1_DR_CLR
.set C1__DR_INV, CYREG_GPIO_PRT1_DR_INV
.set C1__DR_SET, CYREG_GPIO_PRT1_DR_SET
.set C1__INTCFG, CYREG_GPIO_PRT1_INTR_CFG
.set C1__INTR, CYREG_GPIO_PRT1_INTR
.set C1__INTR_CFG, CYREG_GPIO_PRT1_INTR_CFG
.set C1__INTSTAT, CYREG_GPIO_PRT1_INTR
.set C1__MASK, 0x08
.set C1__PA__CFG0, CYREG_UDB_PA1_CFG0
.set C1__PA__CFG1, CYREG_UDB_PA1_CFG1
.set C1__PA__CFG10, CYREG_UDB_PA1_CFG10
.set C1__PA__CFG11, CYREG_UDB_PA1_CFG11
.set C1__PA__CFG12, CYREG_UDB_PA1_CFG12
.set C1__PA__CFG13, CYREG_UDB_PA1_CFG13
.set C1__PA__CFG14, CYREG_UDB_PA1_CFG14
.set C1__PA__CFG2, CYREG_UDB_PA1_CFG2
.set C1__PA__CFG3, CYREG_UDB_PA1_CFG3
.set C1__PA__CFG4, CYREG_UDB_PA1_CFG4
.set C1__PA__CFG5, CYREG_UDB_PA1_CFG5
.set C1__PA__CFG6, CYREG_UDB_PA1_CFG6
.set C1__PA__CFG7, CYREG_UDB_PA1_CFG7
.set C1__PA__CFG8, CYREG_UDB_PA1_CFG8
.set C1__PA__CFG9, CYREG_UDB_PA1_CFG9
.set C1__PC, CYREG_GPIO_PRT1_PC
.set C1__PC2, CYREG_GPIO_PRT1_PC2
.set C1__PORT, 1
.set C1__PS, CYREG_GPIO_PRT1_PS
.set C1__SHIFT, 3

/* C2 */
.set C2__0__DR, CYREG_GPIO_PRT5_DR
.set C2__0__DR_CLR, CYREG_GPIO_PRT5_DR_CLR
.set C2__0__DR_INV, CYREG_GPIO_PRT5_DR_INV
.set C2__0__DR_SET, CYREG_GPIO_PRT5_DR_SET
.set C2__0__HSIOM, CYREG_HSIOM_PORT_SEL5
.set C2__0__HSIOM_MASK, 0x0000F000
.set C2__0__HSIOM_SHIFT, 12
.set C2__0__INTCFG, CYREG_GPIO_PRT5_INTR_CFG
.set C2__0__INTR, CYREG_GPIO_PRT5_INTR
.set C2__0__INTR_CFG, CYREG_GPIO_PRT5_INTR_CFG
.set C2__0__INTSTAT, CYREG_GPIO_PRT5_INTR
.set C2__0__MASK, 0x08
.set C2__0__PC, CYREG_GPIO_PRT5_PC
.set C2__0__PC2, CYREG_GPIO_PRT5_PC2
.set C2__0__PORT, 5
.set C2__0__PS, CYREG_GPIO_PRT5_PS
.set C2__0__SHIFT, 3
.set C2__DR, CYREG_GPIO_PRT5_DR
.set C2__DR_CLR, CYREG_GPIO_PRT5_DR_CLR
.set C2__DR_INV, CYREG_GPIO_PRT5_DR_INV
.set C2__DR_SET, CYREG_GPIO_PRT5_DR_SET
.set C2__INTCFG, CYREG_GPIO_PRT5_INTR_CFG
.set C2__INTR, CYREG_GPIO_PRT5_INTR
.set C2__INTR_CFG, CYREG_GPIO_PRT5_INTR_CFG
.set C2__INTSTAT, CYREG_GPIO_PRT5_INTR
.set C2__MASK, 0x08
.set C2__PC, CYREG_GPIO_PRT5_PC
.set C2__PC2, CYREG_GPIO_PRT5_PC2
.set C2__PORT, 5
.set C2__PS, CYREG_GPIO_PRT5_PS
.set C2__SHIFT, 3

/* C3 */
.set C3__0__DR, CYREG_GPIO_PRT5_DR
.set C3__0__DR_CLR, CYREG_GPIO_PRT5_DR_CLR
.set C3__0__DR_INV, CYREG_GPIO_PRT5_DR_INV
.set C3__0__DR_SET, CYREG_GPIO_PRT5_DR_SET
.set C3__0__HSIOM, CYREG_HSIOM_PORT_SEL5
.set C3__0__HSIOM_MASK, 0x00F00000
.set C3__0__HSIOM_SHIFT, 20
.set C3__0__INTCFG, CYREG_GPIO_PRT5_INTR_CFG
.set C3__0__INTR, CYREG_GPIO_PRT5_INTR
.set C3__0__INTR_CFG, CYREG_GPIO_PRT5_INTR_CFG
.set C3__0__INTSTAT, CYREG_GPIO_PRT5_INTR
.set C3__0__MASK, 0x20
.set C3__0__PC, CYREG_GPIO_PRT5_PC
.set C3__0__PC2, CYREG_GPIO_PRT5_PC2
.set C3__0__PORT, 5
.set C3__0__PS, CYREG_GPIO_PRT5_PS
.set C3__0__SHIFT, 5
.set C3__DR, CYREG_GPIO_PRT5_DR
.set C3__DR_CLR, CYREG_GPIO_PRT5_DR_CLR
.set C3__DR_INV, CYREG_GPIO_PRT5_DR_INV
.set C3__DR_SET, CYREG_GPIO_PRT5_DR_SET
.set C3__INTCFG, CYREG_GPIO_PRT5_INTR_CFG
.set C3__INTR, CYREG_GPIO_PRT5_INTR
.set C3__INTR_CFG, CYREG_GPIO_PRT5_INTR_CFG
.set C3__INTSTAT, CYREG_GPIO_PRT5_INTR
.set C3__MASK, 0x20
.set C3__PC, CYREG_GPIO_PRT5_PC
.set C3__PC2, CYREG_GPIO_PRT5_PC2
.set C3__PORT, 5
.set C3__PS, CYREG_GPIO_PRT5_PS
.set C3__SHIFT, 5

/* R0 */
.set R0__0__DR, CYREG_GPIO_PRT3_DR
.set R0__0__DR_CLR, CYREG_GPIO_PRT3_DR_CLR
.set R0__0__DR_INV, CYREG_GPIO_PRT3_DR_INV
.set R0__0__DR_SET, CYREG_GPIO_PRT3_DR_SET
.set R0__0__HSIOM, CYREG_HSIOM_PORT_SEL3
.set R0__0__HSIOM_MASK, 0x0000000F
.set R0__0__HSIOM_SHIFT, 0
.set R0__0__INTCFG, CYREG_GPIO_PRT3_INTR_CFG
.set R0__0__INTR, CYREG_GPIO_PRT3_INTR
.set R0__0__INTR_CFG, CYREG_GPIO_PRT3_INTR_CFG
.set R0__0__INTSTAT, CYREG_GPIO_PRT3_INTR
.set R0__0__MASK, 0x01
.set R0__0__PA__CFG0, CYREG_UDB_PA3_CFG0
.set R0__0__PA__CFG1, CYREG_UDB_PA3_CFG1
.set R0__0__PA__CFG10, CYREG_UDB_PA3_CFG10
.set R0__0__PA__CFG11, CYREG_UDB_PA3_CFG11
.set R0__0__PA__CFG12, CYREG_UDB_PA3_CFG12
.set R0__0__PA__CFG13, CYREG_UDB_PA3_CFG13
.set R0__0__PA__CFG14, CYREG_UDB_PA3_CFG14
.set R0__0__PA__CFG2, CYREG_UDB_PA3_CFG2
.set R0__0__PA__CFG3, CYREG_UDB_PA3_CFG3
.set R0__0__PA__CFG4, CYREG_UDB_PA3_CFG4
.set R0__0__PA__CFG5, CYREG_UDB_PA3_CFG5
.set R0__0__PA__CFG6, CYREG_UDB_PA3_CFG6
.set R0__0__PA__CFG7, CYREG_UDB_PA3_CFG7
.set R0__0__PA__CFG8, CYREG_UDB_PA3_CFG8
.set R0__0__PA__CFG9, CYREG_UDB_PA3_CFG9
.set R0__0__PC, CYREG_GPIO_PRT3_PC
.set R0__0__PC2, CYREG_GPIO_PRT3_PC2
.set R0__0__PORT, 3
.set R0__0__PS, CYREG_GPIO_PRT3_PS
.set R0__0__SHIFT, 0
.set R0__DR, CYREG_GPIO_PRT3_DR
.set R0__DR_CLR, CYREG_GPIO_PRT3_DR_CLR
.set R0__DR_INV, CYREG_GPIO_PRT3_DR_INV
.set R0__DR_SET, CYREG_GPIO_PRT3_DR_SET
.set R0__INTCFG, CYREG_GPIO_PRT3_INTR_CFG
.set R0__INTR, CYREG_GPIO_PRT3_INTR
.set R0__INTR_CFG, CYREG_GPIO_PRT3_INTR_CFG
.set R0__INTSTAT, CYREG_GPIO_PRT3_INTR
.set R0__MASK, 0x01
.set R0__PA__CFG0, CYREG_UDB_PA3_CFG0
.set R0__PA__CFG1, CYREG_UDB_PA3_CFG1
.set R0__PA__CFG10, CYREG_UDB_PA3_CFG10
.set R0__PA__CFG11, CYREG_UDB_PA3_CFG11
.set R0__PA__CFG12, CYREG_UDB_PA3_CFG12
.set R0__PA__CFG13, CYREG_UDB_PA3_CFG13
.set R0__PA__CFG14, CYREG_UDB_PA3_CFG14
.set R0__PA__CFG2, CYREG_UDB_PA3_CFG2
.set R0__PA__CFG3, CYREG_UDB_PA3_CFG3
.set R0__PA__CFG4, CYREG_UDB_PA3_CFG4
.set R0__PA__CFG5, CYREG_UDB_PA3_CFG5
.set R0__PA__CFG6, CYREG_UDB_PA3_CFG6
.set R0__PA__CFG7, CYREG_UDB_PA3_CFG7
.set R0__PA__CFG8, CYREG_UDB_PA3_CFG8
.set R0__PA__CFG9, CYREG_UDB_PA3_CFG9
.set R0__PC, CYREG_GPIO_PRT3_PC
.set R0__PC2, CYREG_GPIO_PRT3_PC2
.set R0__PORT, 3
.set R0__PS, CYREG_GPIO_PRT3_PS
.set R0__SHIFT, 0

/* R1 */
.set R1__0__DR, CYREG_GPIO_PRT3_DR
.set R1__0__DR_CLR, CYREG_GPIO_PRT3_DR_CLR
.set R1__0__DR_INV, CYREG_GPIO_PRT3_DR_INV
.set R1__0__DR_SET, CYREG_GPIO_PRT3_DR_SET
.set R1__0__HSIOM, CYREG_HSIOM_PORT_SEL3
.set R1__0__HSIOM_MASK, 0x000000F0
.set R1__0__HSIOM_SHIFT, 4
.set R1__0__INTCFG, CYREG_GPIO_PRT3_INTR_CFG
.set R1__0__INTR, CYREG_GPIO_PRT3_INTR
.set R1__0__INTR_CFG, CYREG_GPIO_PRT3_INTR_CFG
.set R1__0__INTSTAT, CYREG_GPIO_PRT3_INTR
.set R1__0__MASK, 0x02
.set R1__0__PA__CFG0, CYREG_UDB_PA3_CFG0
.set R1__0__PA__CFG1, CYREG_UDB_PA3_CFG1
.set R1__0__PA__CFG10, CYREG_UDB_PA3_CFG10
.set R1__0__PA__CFG11, CYREG_UDB_PA3_CFG11
.set R1__0__PA__CFG12, CYREG_UDB_PA3_CFG12
.set R1__0__PA__CFG13, CYREG_UDB_PA3_CFG13
.set R1__0__PA__CFG14, CYREG_UDB_PA3_CFG14
.set R1__0__PA__CFG2, CYREG_UDB_PA3_CFG2
.set R1__0__PA__CFG3, CYREG_UDB_PA3_CFG3
.set R1__0__PA__CFG4, CYREG_UDB_PA3_CFG4
.set R1__0__PA__CFG5, CYREG_UDB_PA3_CFG5
.set R1__0__PA__CFG6, CYREG_UDB_PA3_CFG6
.set R1__0__PA__CFG7, CYREG_UDB_PA3_CFG7
.set R1__0__PA__CFG8, CYREG_UDB_PA3_CFG8
.set R1__0__PA__CFG9, CYREG_UDB_PA3_CFG9
.set R1__0__PC, CYREG_GPIO_PRT3_PC
.set R1__0__PC2, CYREG_GPIO_PRT3_PC2
.set R1__0__PORT, 3
.set R1__0__PS, CYREG_GPIO_PRT3_PS
.set R1__0__SHIFT, 1
.set R1__DR, CYREG_GPIO_PRT3_DR
.set R1__DR_CLR, CYREG_GPIO_PRT3_DR_CLR
.set R1__DR_INV, CYREG_GPIO_PRT3_DR_INV
.set R1__DR_SET, CYREG_GPIO_PRT3_DR_SET
.set R1__INTCFG, CYREG_GPIO_PRT3_INTR_CFG
.set R1__INTR, CYREG_GPIO_PRT3_INTR
.set R1__INTR_CFG, CYREG_GPIO_PRT3_INTR_CFG
.set R1__INTSTAT, CYREG_GPIO_PRT3_INTR
.set R1__MASK, 0x02
.set R1__PA__CFG0, CYREG_UDB_PA3_CFG0
.set R1__PA__CFG1, CYREG_UDB_PA3_CFG1
.set R1__PA__CFG10, CYREG_UDB_PA3_CFG10
.set R1__PA__CFG11, CYREG_UDB_PA3_CFG11
.set R1__PA__CFG12, CYREG_UDB_PA3_CFG12
.set R1__PA__CFG13, CYREG_UDB_PA3_CFG13
.set R1__PA__CFG14, CYREG_UDB_PA3_CFG14
.set R1__PA__CFG2, CYREG_UDB_PA3_CFG2
.set R1__PA__CFG3, CYREG_UDB_PA3_CFG3
.set R1__PA__CFG4, CYREG_UDB_PA3_CFG4
.set R1__PA__CFG5, CYREG_UDB_PA3_CFG5
.set R1__PA__CFG6, CYREG_UDB_PA3_CFG6
.set R1__PA__CFG7, CYREG_UDB_PA3_CFG7
.set R1__PA__CFG8, CYREG_UDB_PA3_CFG8
.set R1__PA__CFG9, CYREG_UDB_PA3_CFG9
.set R1__PC, CYREG_GPIO_PRT3_PC
.set R1__PC2, CYREG_GPIO_PRT3_PC2
.set R1__PORT, 3
.set R1__PS, CYREG_GPIO_PRT3_PS
.set R1__SHIFT, 1

/* R2 */
.set R2__0__DR, CYREG_GPIO_PRT1_DR
.set R2__0__DR_CLR, CYREG_GPIO_PRT1_DR_CLR
.set R2__0__DR_INV, CYREG_GPIO_PRT1_DR_INV
.set R2__0__DR_SET, CYREG_GPIO_PRT1_DR_SET
.set R2__0__HSIOM, CYREG_HSIOM_PORT_SEL1
.set R2__0__HSIOM_MASK, 0x0000000F
.set R2__0__HSIOM_SHIFT, 0
.set R2__0__INTCFG, CYREG_GPIO_PRT1_INTR_CFG
.set R2__0__INTR, CYREG_GPIO_PRT1_INTR
.set R2__0__INTR_CFG, CYREG_GPIO_PRT1_INTR_CFG
.set R2__0__INTSTAT, CYREG_GPIO_PRT1_INTR
.set R2__0__MASK, 0x01
.set R2__0__PA__CFG0, CYREG_UDB_PA1_CFG0
.set R2__0__PA__CFG1, CYREG_UDB_PA1_CFG1
.set R2__0__PA__CFG10, CYREG_UDB_PA1_CFG10
.set R2__0__PA__CFG11, CYREG_UDB_PA1_CFG11
.set R2__0__PA__CFG12, CYREG_UDB_PA1_CFG12
.set R2__0__PA__CFG13, CYREG_UDB_PA1_CFG13
.set R2__0__PA__CFG14, CYREG_UDB_PA1_CFG14
.set R2__0__PA__CFG2, CYREG_UDB_PA1_CFG2
.set R2__0__PA__CFG3, CYREG_UDB_PA1_CFG3
.set R2__0__PA__CFG4, CYREG_UDB_PA1_CFG4
.set R2__0__PA__CFG5, CYREG_UDB_PA1_CFG5
.set R2__0__PA__CFG6, CYREG_UDB_PA1_CFG6
.set R2__0__PA__CFG7, CYREG_UDB_PA1_CFG7
.set R2__0__PA__CFG8, CYREG_UDB_PA1_CFG8
.set R2__0__PA__CFG9, CYREG_UDB_PA1_CFG9
.set R2__0__PC, CYREG_GPIO_PRT1_PC
.set R2__0__PC2, CYREG_GPIO_PRT1_PC2
.set R2__0__PORT, 1
.set R2__0__PS, CYREG_GPIO_PRT1_PS
.set R2__0__SHIFT, 0
.set R2__DR, CYREG_GPIO_PRT1_DR
.set R2__DR_CLR, CYREG_GPIO_PRT1_DR_CLR
.set R2__DR_INV, CYREG_GPIO_PRT1_DR_INV
.set R2__DR_SET, CYREG_GPIO_PRT1_DR_SET
.set R2__INTCFG, CYREG_GPIO_PRT1_INTR_CFG
.set R2__INTR, CYREG_GPIO_PRT1_INTR
.set R2__INTR_CFG, CYREG_GPIO_PRT1_INTR_CFG
.set R2__INTSTAT, CYREG_GPIO_PRT1_INTR
.set R2__MASK, 0x01
.set R2__PA__CFG0, CYREG_UDB_PA1_CFG0
.set R2__PA__CFG1, CYREG_UDB_PA1_CFG1
.set R2__PA__CFG10, CYREG_UDB_PA1_CFG10
.set R2__PA__CFG11, CYREG_UDB_PA1_CFG11
.set R2__PA__CFG12, CYREG_UDB_PA1_CFG12
.set R2__PA__CFG13, CYREG_UDB_PA1_CFG13
.set R2__PA__CFG14, CYREG_UDB_PA1_CFG14
.set R2__PA__CFG2, CYREG_UDB_PA1_CFG2
.set R2__PA__CFG3, CYREG_UDB_PA1_CFG3
.set R2__PA__CFG4, CYREG_UDB_PA1_CFG4
.set R2__PA__CFG5, CYREG_UDB_PA1_CFG5
.set R2__PA__CFG6, CYREG_UDB_PA1_CFG6
.set R2__PA__CFG7, CYREG_UDB_PA1_CFG7
.set R2__PA__CFG8, CYREG_UDB_PA1_CFG8
.set R2__PA__CFG9, CYREG_UDB_PA1_CFG9
.set R2__PC, CYREG_GPIO_PRT1_PC
.set R2__PC2, CYREG_GPIO_PRT1_PC2
.set R2__PORT, 1
.set R2__PS, CYREG_GPIO_PRT1_PS
.set R2__SHIFT, 0

/* R3 */
.set R3__0__DR, CYREG_GPIO_PRT1_DR
.set R3__0__DR_CLR, CYREG_GPIO_PRT1_DR_CLR
.set R3__0__DR_INV, CYREG_GPIO_PRT1_DR_INV
.set R3__0__DR_SET, CYREG_GPIO_PRT1_DR_SET
.set R3__0__HSIOM, CYREG_HSIOM_PORT_SEL1
.set R3__0__HSIOM_MASK, 0x000000F0
.set R3__0__HSIOM_SHIFT, 4
.set R3__0__INTCFG, CYREG_GPIO_PRT1_INTR_CFG
.set R3__0__INTR, CYREG_GPIO_PRT1_INTR
.set R3__0__INTR_CFG, CYREG_GPIO_PRT1_INTR_CFG
.set R3__0__INTSTAT, CYREG_GPIO_PRT1_INTR
.set R3__0__MASK, 0x02
.set R3__0__PA__CFG0, CYREG_UDB_PA1_CFG0
.set R3__0__PA__CFG1, CYREG_UDB_PA1_CFG1
.set R3__0__PA__CFG10, CYREG_UDB_PA1_CFG10
.set R3__0__PA__CFG11, CYREG_UDB_PA1_CFG11
.set R3__0__PA__CFG12, CYREG_UDB_PA1_CFG12
.set R3__0__PA__CFG13, CYREG_UDB_PA1_CFG13
.set R3__0__PA__CFG14, CYREG_UDB_PA1_CFG14
.set R3__0__PA__CFG2, CYREG_UDB_PA1_CFG2
.set R3__0__PA__CFG3, CYREG_UDB_PA1_CFG3
.set R3__0__PA__CFG4, CYREG_UDB_PA1_CFG4
.set R3__0__PA__CFG5, CYREG_UDB_PA1_CFG5
.set R3__0__PA__CFG6, CYREG_UDB_PA1_CFG6
.set R3__0__PA__CFG7, CYREG_UDB_PA1_CFG7
.set R3__0__PA__CFG8, CYREG_UDB_PA1_CFG8
.set R3__0__PA__CFG9, CYREG_UDB_PA1_CFG9
.set R3__0__PC, CYREG_GPIO_PRT1_PC
.set R3__0__PC2, CYREG_GPIO_PRT1_PC2
.set R3__0__PORT, 1
.set R3__0__PS, CYREG_GPIO_PRT1_PS
.set R3__0__SHIFT, 1
.set R3__DR, CYREG_GPIO_PRT1_DR
.set R3__DR_CLR, CYREG_GPIO_PRT1_DR_CLR
.set R3__DR_INV, CYREG_GPIO_PRT1_DR_INV
.set R3__DR_SET, CYREG_GPIO_PRT1_DR_SET
.set R3__INTCFG, CYREG_GPIO_PRT1_INTR_CFG
.set R3__INTR, CYREG_GPIO_PRT1_INTR
.set R3__INTR_CFG, CYREG_GPIO_PRT1_INTR_CFG
.set R3__INTSTAT, CYREG_GPIO_PRT1_INTR
.set R3__MASK, 0x02
.set R3__PA__CFG0, CYREG_UDB_PA1_CFG0
.set R3__PA__CFG1, CYREG_UDB_PA1_CFG1
.set R3__PA__CFG10, CYREG_UDB_PA1_CFG10
.set R3__PA__CFG11, CYREG_UDB_PA1_CFG11
.set R3__PA__CFG12, CYREG_UDB_PA1_CFG12
.set R3__PA__CFG13, CYREG_UDB_PA1_CFG13
.set R3__PA__CFG14, CYREG_UDB_PA1_CFG14
.set R3__PA__CFG2, CYREG_UDB_PA1_CFG2
.set R3__PA__CFG3, CYREG_UDB_PA1_CFG3
.set R3__PA__CFG4, CYREG_UDB_PA1_CFG4
.set R3__PA__CFG5, CYREG_UDB_PA1_CFG5
.set R3__PA__CFG6, CYREG_UDB_PA1_CFG6
.set R3__PA__CFG7, CYREG_UDB_PA1_CFG7
.set R3__PA__CFG8, CYREG_UDB_PA1_CFG8
.set R3__PA__CFG9, CYREG_UDB_PA1_CFG9
.set R3__PC, CYREG_GPIO_PRT1_PC
.set R3__PC2, CYREG_GPIO_PRT1_PC2
.set R3__PORT, 1
.set R3__PS, CYREG_GPIO_PRT1_PS
.set R3__SHIFT, 1

/* LCD_LCDPort */
.set LCD_LCDPort__0__DR, CYREG_GPIO_PRT2_DR
.set LCD_LCDPort__0__DR_CLR, CYREG_GPIO_PRT2_DR_CLR
.set LCD_LCDPort__0__DR_INV, CYREG_GPIO_PRT2_DR_INV
.set LCD_LCDPort__0__DR_SET, CYREG_GPIO_PRT2_DR_SET
.set LCD_LCDPort__0__HSIOM, CYREG_HSIOM_PORT_SEL2
.set LCD_LCDPort__0__HSIOM_MASK, 0x0000000F
.set LCD_LCDPort__0__HSIOM_SHIFT, 0
.set LCD_LCDPort__0__INTCFG, CYREG_GPIO_PRT2_INTR_CFG
.set LCD_LCDPort__0__INTR, CYREG_GPIO_PRT2_INTR
.set LCD_LCDPort__0__INTR_CFG, CYREG_GPIO_PRT2_INTR_CFG
.set LCD_LCDPort__0__INTSTAT, CYREG_GPIO_PRT2_INTR
.set LCD_LCDPort__0__MASK, 0x01
.set LCD_LCDPort__0__PA__CFG0, CYREG_UDB_PA2_CFG0
.set LCD_LCDPort__0__PA__CFG1, CYREG_UDB_PA2_CFG1
.set LCD_LCDPort__0__PA__CFG10, CYREG_UDB_PA2_CFG10
.set LCD_LCDPort__0__PA__CFG11, CYREG_UDB_PA2_CFG11
.set LCD_LCDPort__0__PA__CFG12, CYREG_UDB_PA2_CFG12
.set LCD_LCDPort__0__PA__CFG13, CYREG_UDB_PA2_CFG13
.set LCD_LCDPort__0__PA__CFG14, CYREG_UDB_PA2_CFG14
.set LCD_LCDPort__0__PA__CFG2, CYREG_UDB_PA2_CFG2
.set LCD_LCDPort__0__PA__CFG3, CYREG_UDB_PA2_CFG3
.set LCD_LCDPort__0__PA__CFG4, CYREG_UDB_PA2_CFG4
.set LCD_LCDPort__0__PA__CFG5, CYREG_UDB_PA2_CFG5
.set LCD_LCDPort__0__PA__CFG6, CYREG_UDB_PA2_CFG6
.set LCD_LCDPort__0__PA__CFG7, CYREG_UDB_PA2_CFG7
.set LCD_LCDPort__0__PA__CFG8, CYREG_UDB_PA2_CFG8
.set LCD_LCDPort__0__PA__CFG9, CYREG_UDB_PA2_CFG9
.set LCD_LCDPort__0__PC, CYREG_GPIO_PRT2_PC
.set LCD_LCDPort__0__PC2, CYREG_GPIO_PRT2_PC2
.set LCD_LCDPort__0__PORT, 2
.set LCD_LCDPort__0__PS, CYREG_GPIO_PRT2_PS
.set LCD_LCDPort__0__SHIFT, 0
.set LCD_LCDPort__1__DR, CYREG_GPIO_PRT2_DR
.set LCD_LCDPort__1__DR_CLR, CYREG_GPIO_PRT2_DR_CLR
.set LCD_LCDPort__1__DR_INV, CYREG_GPIO_PRT2_DR_INV
.set LCD_LCDPort__1__DR_SET, CYREG_GPIO_PRT2_DR_SET
.set LCD_LCDPort__1__HSIOM, CYREG_HSIOM_PORT_SEL2
.set LCD_LCDPort__1__HSIOM_MASK, 0x000000F0
.set LCD_LCDPort__1__HSIOM_SHIFT, 4
.set LCD_LCDPort__1__INTCFG, CYREG_GPIO_PRT2_INTR_CFG
.set LCD_LCDPort__1__INTR, CYREG_GPIO_PRT2_INTR
.set LCD_LCDPort__1__INTR_CFG, CYREG_GPIO_PRT2_INTR_CFG
.set LCD_LCDPort__1__INTSTAT, CYREG_GPIO_PRT2_INTR
.set LCD_LCDPort__1__MASK, 0x02
.set LCD_LCDPort__1__PA__CFG0, CYREG_UDB_PA2_CFG0
.set LCD_LCDPort__1__PA__CFG1, CYREG_UDB_PA2_CFG1
.set LCD_LCDPort__1__PA__CFG10, CYREG_UDB_PA2_CFG10
.set LCD_LCDPort__1__PA__CFG11, CYREG_UDB_PA2_CFG11
.set LCD_LCDPort__1__PA__CFG12, CYREG_UDB_PA2_CFG12
.set LCD_LCDPort__1__PA__CFG13, CYREG_UDB_PA2_CFG13
.set LCD_LCDPort__1__PA__CFG14, CYREG_UDB_PA2_CFG14
.set LCD_LCDPort__1__PA__CFG2, CYREG_UDB_PA2_CFG2
.set LCD_LCDPort__1__PA__CFG3, CYREG_UDB_PA2_CFG3
.set LCD_LCDPort__1__PA__CFG4, CYREG_UDB_PA2_CFG4
.set LCD_LCDPort__1__PA__CFG5, CYREG_UDB_PA2_CFG5
.set LCD_LCDPort__1__PA__CFG6, CYREG_UDB_PA2_CFG6
.set LCD_LCDPort__1__PA__CFG7, CYREG_UDB_PA2_CFG7
.set LCD_LCDPort__1__PA__CFG8, CYREG_UDB_PA2_CFG8
.set LCD_LCDPort__1__PA__CFG9, CYREG_UDB_PA2_CFG9
.set LCD_LCDPort__1__PC, CYREG_GPIO_PRT2_PC
.set LCD_LCDPort__1__PC2, CYREG_GPIO_PRT2_PC2
.set LCD_LCDPort__1__PORT, 2
.set LCD_LCDPort__1__PS, CYREG_GPIO_PRT2_PS
.set LCD_LCDPort__1__SHIFT, 1
.set LCD_LCDPort__2__DR, CYREG_GPIO_PRT2_DR
.set LCD_LCDPort__2__DR_CLR, CYREG_GPIO_PRT2_DR_CLR
.set LCD_LCDPort__2__DR_INV, CYREG_GPIO_PRT2_DR_INV
.set LCD_LCDPort__2__DR_SET, CYREG_GPIO_PRT2_DR_SET
.set LCD_LCDPort__2__HSIOM, CYREG_HSIOM_PORT_SEL2
.set LCD_LCDPort__2__HSIOM_MASK, 0x00000F00
.set LCD_LCDPort__2__HSIOM_SHIFT, 8
.set LCD_LCDPort__2__INTCFG, CYREG_GPIO_PRT2_INTR_CFG
.set LCD_LCDPort__2__INTR, CYREG_GPIO_PRT2_INTR
.set LCD_LCDPort__2__INTR_CFG, CYREG_GPIO_PRT2_INTR_CFG
.set LCD_LCDPort__2__INTSTAT, CYREG_GPIO_PRT2_INTR
.set LCD_LCDPort__2__MASK, 0x04
.set LCD_LCDPort__2__PA__CFG0, CYREG_UDB_PA2_CFG0
.set LCD_LCDPort__2__PA__CFG1, CYREG_UDB_PA2_CFG1
.set LCD_LCDPort__2__PA__CFG10, CYREG_UDB_PA2_CFG10
.set LCD_LCDPort__2__PA__CFG11, CYREG_UDB_PA2_CFG11
.set LCD_LCDPort__2__PA__CFG12, CYREG_UDB_PA2_CFG12
.set LCD_LCDPort__2__PA__CFG13, CYREG_UDB_PA2_CFG13
.set LCD_LCDPort__2__PA__CFG14, CYREG_UDB_PA2_CFG14
.set LCD_LCDPort__2__PA__CFG2, CYREG_UDB_PA2_CFG2
.set LCD_LCDPort__2__PA__CFG3, CYREG_UDB_PA2_CFG3
.set LCD_LCDPort__2__PA__CFG4, CYREG_UDB_PA2_CFG4
.set LCD_LCDPort__2__PA__CFG5, CYREG_UDB_PA2_CFG5
.set LCD_LCDPort__2__PA__CFG6, CYREG_UDB_PA2_CFG6
.set LCD_LCDPort__2__PA__CFG7, CYREG_UDB_PA2_CFG7
.set LCD_LCDPort__2__PA__CFG8, CYREG_UDB_PA2_CFG8
.set LCD_LCDPort__2__PA__CFG9, CYREG_UDB_PA2_CFG9
.set LCD_LCDPort__2__PC, CYREG_GPIO_PRT2_PC
.set LCD_LCDPort__2__PC2, CYREG_GPIO_PRT2_PC2
.set LCD_LCDPort__2__PORT, 2
.set LCD_LCDPort__2__PS, CYREG_GPIO_PRT2_PS
.set LCD_LCDPort__2__SHIFT, 2
.set LCD_LCDPort__3__DR, CYREG_GPIO_PRT2_DR
.set LCD_LCDPort__3__DR_CLR, CYREG_GPIO_PRT2_DR_CLR
.set LCD_LCDPort__3__DR_INV, CYREG_GPIO_PRT2_DR_INV
.set LCD_LCDPort__3__DR_SET, CYREG_GPIO_PRT2_DR_SET
.set LCD_LCDPort__3__HSIOM, CYREG_HSIOM_PORT_SEL2
.set LCD_LCDPort__3__HSIOM_MASK, 0x0000F000
.set LCD_LCDPort__3__HSIOM_SHIFT, 12
.set LCD_LCDPort__3__INTCFG, CYREG_GPIO_PRT2_INTR_CFG
.set LCD_LCDPort__3__INTR, CYREG_GPIO_PRT2_INTR
.set LCD_LCDPort__3__INTR_CFG, CYREG_GPIO_PRT2_INTR_CFG
.set LCD_LCDPort__3__INTSTAT, CYREG_GPIO_PRT2_INTR
.set LCD_LCDPort__3__MASK, 0x08
.set LCD_LCDPort__3__PA__CFG0, CYREG_UDB_PA2_CFG0
.set LCD_LCDPort__3__PA__CFG1, CYREG_UDB_PA2_CFG1
.set LCD_LCDPort__3__PA__CFG10, CYREG_UDB_PA2_CFG10
.set LCD_LCDPort__3__PA__CFG11, CYREG_UDB_PA2_CFG11
.set LCD_LCDPort__3__PA__CFG12, CYREG_UDB_PA2_CFG12
.set LCD_LCDPort__3__PA__CFG13, CYREG_UDB_PA2_CFG13
.set LCD_LCDPort__3__PA__CFG14, CYREG_UDB_PA2_CFG14
.set LCD_LCDPort__3__PA__CFG2, CYREG_UDB_PA2_CFG2
.set LCD_LCDPort__3__PA__CFG3, CYREG_UDB_PA2_CFG3
.set LCD_LCDPort__3__PA__CFG4, CYREG_UDB_PA2_CFG4
.set LCD_LCDPort__3__PA__CFG5, CYREG_UDB_PA2_CFG5
.set LCD_LCDPort__3__PA__CFG6, CYREG_UDB_PA2_CFG6
.set LCD_LCDPort__3__PA__CFG7, CYREG_UDB_PA2_CFG7
.set LCD_LCDPort__3__PA__CFG8, CYREG_UDB_PA2_CFG8
.set LCD_LCDPort__3__PA__CFG9, CYREG_UDB_PA2_CFG9
.set LCD_LCDPort__3__PC, CYREG_GPIO_PRT2_PC
.set LCD_LCDPort__3__PC2, CYREG_GPIO_PRT2_PC2
.set LCD_LCDPort__3__PORT, 2
.set LCD_LCDPort__3__PS, CYREG_GPIO_PRT2_PS
.set LCD_LCDPort__3__SHIFT, 3
.set LCD_LCDPort__4__DR, CYREG_GPIO_PRT2_DR
.set LCD_LCDPort__4__DR_CLR, CYREG_GPIO_PRT2_DR_CLR
.set LCD_LCDPort__4__DR_INV, CYREG_GPIO_PRT2_DR_INV
.set LCD_LCDPort__4__DR_SET, CYREG_GPIO_PRT2_DR_SET
.set LCD_LCDPort__4__HSIOM, CYREG_HSIOM_PORT_SEL2
.set LCD_LCDPort__4__HSIOM_MASK, 0x000F0000
.set LCD_LCDPort__4__HSIOM_SHIFT, 16
.set LCD_LCDPort__4__INTCFG, CYREG_GPIO_PRT2_INTR_CFG
.set LCD_LCDPort__4__INTR, CYREG_GPIO_PRT2_INTR
.set LCD_LCDPort__4__INTR_CFG, CYREG_GPIO_PRT2_INTR_CFG
.set LCD_LCDPort__4__INTSTAT, CYREG_GPIO_PRT2_INTR
.set LCD_LCDPort__4__MASK, 0x10
.set LCD_LCDPort__4__PA__CFG0, CYREG_UDB_PA2_CFG0
.set LCD_LCDPort__4__PA__CFG1, CYREG_UDB_PA2_CFG1
.set LCD_LCDPort__4__PA__CFG10, CYREG_UDB_PA2_CFG10
.set LCD_LCDPort__4__PA__CFG11, CYREG_UDB_PA2_CFG11
.set LCD_LCDPort__4__PA__CFG12, CYREG_UDB_PA2_CFG12
.set LCD_LCDPort__4__PA__CFG13, CYREG_UDB_PA2_CFG13
.set LCD_LCDPort__4__PA__CFG14, CYREG_UDB_PA2_CFG14
.set LCD_LCDPort__4__PA__CFG2, CYREG_UDB_PA2_CFG2
.set LCD_LCDPort__4__PA__CFG3, CYREG_UDB_PA2_CFG3
.set LCD_LCDPort__4__PA__CFG4, CYREG_UDB_PA2_CFG4
.set LCD_LCDPort__4__PA__CFG5, CYREG_UDB_PA2_CFG5
.set LCD_LCDPort__4__PA__CFG6, CYREG_UDB_PA2_CFG6
.set LCD_LCDPort__4__PA__CFG7, CYREG_UDB_PA2_CFG7
.set LCD_LCDPort__4__PA__CFG8, CYREG_UDB_PA2_CFG8
.set LCD_LCDPort__4__PA__CFG9, CYREG_UDB_PA2_CFG9
.set LCD_LCDPort__4__PC, CYREG_GPIO_PRT2_PC
.set LCD_LCDPort__4__PC2, CYREG_GPIO_PRT2_PC2
.set LCD_LCDPort__4__PORT, 2
.set LCD_LCDPort__4__PS, CYREG_GPIO_PRT2_PS
.set LCD_LCDPort__4__SHIFT, 4
.set LCD_LCDPort__5__DR, CYREG_GPIO_PRT2_DR
.set LCD_LCDPort__5__DR_CLR, CYREG_GPIO_PRT2_DR_CLR
.set LCD_LCDPort__5__DR_INV, CYREG_GPIO_PRT2_DR_INV
.set LCD_LCDPort__5__DR_SET, CYREG_GPIO_PRT2_DR_SET
.set LCD_LCDPort__5__HSIOM, CYREG_HSIOM_PORT_SEL2
.set LCD_LCDPort__5__HSIOM_MASK, 0x00F00000
.set LCD_LCDPort__5__HSIOM_SHIFT, 20
.set LCD_LCDPort__5__INTCFG, CYREG_GPIO_PRT2_INTR_CFG
.set LCD_LCDPort__5__INTR, CYREG_GPIO_PRT2_INTR
.set LCD_LCDPort__5__INTR_CFG, CYREG_GPIO_PRT2_INTR_CFG
.set LCD_LCDPort__5__INTSTAT, CYREG_GPIO_PRT2_INTR
.set LCD_LCDPort__5__MASK, 0x20
.set LCD_LCDPort__5__PA__CFG0, CYREG_UDB_PA2_CFG0
.set LCD_LCDPort__5__PA__CFG1, CYREG_UDB_PA2_CFG1
.set LCD_LCDPort__5__PA__CFG10, CYREG_UDB_PA2_CFG10
.set LCD_LCDPort__5__PA__CFG11, CYREG_UDB_PA2_CFG11
.set LCD_LCDPort__5__PA__CFG12, CYREG_UDB_PA2_CFG12
.set LCD_LCDPort__5__PA__CFG13, CYREG_UDB_PA2_CFG13
.set LCD_LCDPort__5__PA__CFG14, CYREG_UDB_PA2_CFG14
.set LCD_LCDPort__5__PA__CFG2, CYREG_UDB_PA2_CFG2
.set LCD_LCDPort__5__PA__CFG3, CYREG_UDB_PA2_CFG3
.set LCD_LCDPort__5__PA__CFG4, CYREG_UDB_PA2_CFG4
.set LCD_LCDPort__5__PA__CFG5, CYREG_UDB_PA2_CFG5
.set LCD_LCDPort__5__PA__CFG6, CYREG_UDB_PA2_CFG6
.set LCD_LCDPort__5__PA__CFG7, CYREG_UDB_PA2_CFG7
.set LCD_LCDPort__5__PA__CFG8, CYREG_UDB_PA2_CFG8
.set LCD_LCDPort__5__PA__CFG9, CYREG_UDB_PA2_CFG9
.set LCD_LCDPort__5__PC, CYREG_GPIO_PRT2_PC
.set LCD_LCDPort__5__PC2, CYREG_GPIO_PRT2_PC2
.set LCD_LCDPort__5__PORT, 2
.set LCD_LCDPort__5__PS, CYREG_GPIO_PRT2_PS
.set LCD_LCDPort__5__SHIFT, 5
.set LCD_LCDPort__6__DR, CYREG_GPIO_PRT2_DR
.set LCD_LCDPort__6__DR_CLR, CYREG_GPIO_PRT2_DR_CLR
.set LCD_LCDPort__6__DR_INV, CYREG_GPIO_PRT2_DR_INV
.set LCD_LCDPort__6__DR_SET, CYREG_GPIO_PRT2_DR_SET
.set LCD_LCDPort__6__HSIOM, CYREG_HSIOM_PORT_SEL2
.set LCD_LCDPort__6__HSIOM_MASK, 0x0F000000
.set LCD_LCDPort__6__HSIOM_SHIFT, 24
.set LCD_LCDPort__6__INTCFG, CYREG_GPIO_PRT2_INTR_CFG
.set LCD_LCDPort__6__INTR, CYREG_GPIO_PRT2_INTR
.set LCD_LCDPort__6__INTR_CFG, CYREG_GPIO_PRT2_INTR_CFG
.set LCD_LCDPort__6__INTSTAT, CYREG_GPIO_PRT2_INTR
.set LCD_LCDPort__6__MASK, 0x40
.set LCD_LCDPort__6__PA__CFG0, CYREG_UDB_PA2_CFG0
.set LCD_LCDPort__6__PA__CFG1, CYREG_UDB_PA2_CFG1
.set LCD_LCDPort__6__PA__CFG10, CYREG_UDB_PA2_CFG10
.set LCD_LCDPort__6__PA__CFG11, CYREG_UDB_PA2_CFG11
.set LCD_LCDPort__6__PA__CFG12, CYREG_UDB_PA2_CFG12
.set LCD_LCDPort__6__PA__CFG13, CYREG_UDB_PA2_CFG13
.set LCD_LCDPort__6__PA__CFG14, CYREG_UDB_PA2_CFG14
.set LCD_LCDPort__6__PA__CFG2, CYREG_UDB_PA2_CFG2
.set LCD_LCDPort__6__PA__CFG3, CYREG_UDB_PA2_CFG3
.set LCD_LCDPort__6__PA__CFG4, CYREG_UDB_PA2_CFG4
.set LCD_LCDPort__6__PA__CFG5, CYREG_UDB_PA2_CFG5
.set LCD_LCDPort__6__PA__CFG6, CYREG_UDB_PA2_CFG6
.set LCD_LCDPort__6__PA__CFG7, CYREG_UDB_PA2_CFG7
.set LCD_LCDPort__6__PA__CFG8, CYREG_UDB_PA2_CFG8
.set LCD_LCDPort__6__PA__CFG9, CYREG_UDB_PA2_CFG9
.set LCD_LCDPort__6__PC, CYREG_GPIO_PRT2_PC
.set LCD_LCDPort__6__PC2, CYREG_GPIO_PRT2_PC2
.set LCD_LCDPort__6__PORT, 2
.set LCD_LCDPort__6__PS, CYREG_GPIO_PRT2_PS
.set LCD_LCDPort__6__SHIFT, 6
.set LCD_LCDPort__DR, CYREG_GPIO_PRT2_DR
.set LCD_LCDPort__DR_CLR, CYREG_GPIO_PRT2_DR_CLR
.set LCD_LCDPort__DR_INV, CYREG_GPIO_PRT2_DR_INV
.set LCD_LCDPort__DR_SET, CYREG_GPIO_PRT2_DR_SET
.set LCD_LCDPort__INTCFG, CYREG_GPIO_PRT2_INTR_CFG
.set LCD_LCDPort__INTR, CYREG_GPIO_PRT2_INTR
.set LCD_LCDPort__INTR_CFG, CYREG_GPIO_PRT2_INTR_CFG
.set LCD_LCDPort__INTSTAT, CYREG_GPIO_PRT2_INTR
.set LCD_LCDPort__MASK, 0x7F
.set LCD_LCDPort__PA__CFG0, CYREG_UDB_PA2_CFG0
.set LCD_LCDPort__PA__CFG1, CYREG_UDB_PA2_CFG1
.set LCD_LCDPort__PA__CFG10, CYREG_UDB_PA2_CFG10
.set LCD_LCDPort__PA__CFG11, CYREG_UDB_PA2_CFG11
.set LCD_LCDPort__PA__CFG12, CYREG_UDB_PA2_CFG12
.set LCD_LCDPort__PA__CFG13, CYREG_UDB_PA2_CFG13
.set LCD_LCDPort__PA__CFG14, CYREG_UDB_PA2_CFG14
.set LCD_LCDPort__PA__CFG2, CYREG_UDB_PA2_CFG2
.set LCD_LCDPort__PA__CFG3, CYREG_UDB_PA2_CFG3
.set LCD_LCDPort__PA__CFG4, CYREG_UDB_PA2_CFG4
.set LCD_LCDPort__PA__CFG5, CYREG_UDB_PA2_CFG5
.set LCD_LCDPort__PA__CFG6, CYREG_UDB_PA2_CFG6
.set LCD_LCDPort__PA__CFG7, CYREG_UDB_PA2_CFG7
.set LCD_LCDPort__PA__CFG8, CYREG_UDB_PA2_CFG8
.set LCD_LCDPort__PA__CFG9, CYREG_UDB_PA2_CFG9
.set LCD_LCDPort__PC, CYREG_GPIO_PRT2_PC
.set LCD_LCDPort__PC2, CYREG_GPIO_PRT2_PC2
.set LCD_LCDPort__PORT, 2
.set LCD_LCDPort__PS, CYREG_GPIO_PRT2_PS
.set LCD_LCDPort__SHIFT, 0

/* Miscellaneous */
.set CYDEV_BCLK__HFCLK__HZ, 48000000
.set CYDEV_BCLK__HFCLK__KHZ, 48000
.set CYDEV_BCLK__HFCLK__MHZ, 48
.set CYDEV_BCLK__SYSCLK__HZ, 48000000
.set CYDEV_BCLK__SYSCLK__KHZ, 48000
.set CYDEV_BCLK__SYSCLK__MHZ, 48
.set CYDEV_CHIP_DIE_LEOPARD, 1
.set CYDEV_CHIP_DIE_PSOC4A, 18
.set CYDEV_CHIP_DIE_PSOC5LP, 2
.set CYDEV_CHIP_DIE_PSOC5TM, 3
.set CYDEV_CHIP_DIE_TMA4, 4
.set CYDEV_CHIP_DIE_UNKNOWN, 0
.set CYDEV_CHIP_FAMILY_FM0P, 5
.set CYDEV_CHIP_FAMILY_FM3, 6
.set CYDEV_CHIP_FAMILY_FM4, 7
.set CYDEV_CHIP_FAMILY_PSOC3, 1
.set CYDEV_CHIP_FAMILY_PSOC4, 2
.set CYDEV_CHIP_FAMILY_PSOC5, 3
.set CYDEV_CHIP_FAMILY_PSOC6, 4
.set CYDEV_CHIP_FAMILY_UNKNOWN, 0
.set CYDEV_CHIP_FAMILY_USED, CYDEV_CHIP_FAMILY_PSOC4
.set CYDEV_CHIP_JTAG_ID, 0x112D11A1
.set CYDEV_CHIP_MEMBER_3A, 1
.set CYDEV_CHIP_MEMBER_4A, 18
.set CYDEV_CHIP_MEMBER_4D, 13
.set CYDEV_CHIP_MEMBER_4E, 6
.set CYDEV_CHIP_MEMBER_4F, 19
.set CYDEV_CHIP_MEMBER_4G, 4
.set CYDEV_CHIP_MEMBER_4H, 17
.set CYDEV_CHIP_MEMBER_4I, 23
.set CYDEV_CHIP_MEMBER_4J, 14
.set CYDEV_CHIP_MEMBER_4K, 15
.set CYDEV_CHIP_MEMBER_4L, 22
.set CYDEV_CHIP_MEMBER_4M, 21
.set CYDEV_CHIP_MEMBER_4N, 10
.set CYDEV_CHIP_MEMBER_4O, 7
.set CYDEV_CHIP_MEMBER_4P, 20
.set CYDEV_CHIP_MEMBER_4Q, 12
.set CYDEV_CHIP_MEMBER_4R, 8
.set CYDEV_CHIP_MEMBER_4S, 11
.set CYDEV_CHIP_MEMBER_4T, 9
.set CYDEV_CHIP_MEMBER_4U, 5
.set CYDEV_CHIP_MEMBER_4V, 16
.set CYDEV_CHIP_MEMBER_5A, 3
.set CYDEV_CHIP_MEMBER_5B, 2
.set CYDEV_CHIP_MEMBER_6A, 24
.set CYDEV_CHIP_MEMBER_FM3, 28
.set CYDEV_CHIP_MEMBER_FM4, 29
.set CYDEV_CHIP_MEMBER_PDL_FM0P_TYPE1, 25
.set CYDEV_CHIP_MEMBER_PDL_FM0P_TYPE2, 26
.set CYDEV_CHIP_MEMBER_PDL_FM0P_TYPE3, 27
.set CYDEV_CHIP_MEMBER_UNKNOWN, 0
.set CYDEV_CHIP_MEMBER_USED, CYDEV_CHIP_MEMBER_4M
.set CYDEV_CHIP_DIE_EXPECT, CYDEV_CHIP_MEMBER_USED
.set CYDEV_CHIP_DIE_ACTUAL, CYDEV_CHIP_DIE_EXPECT
.set CYDEV_CHIP_REV_LEOPARD_ES1, 0
.set CYDEV_CHIP_REV_LEOPARD_ES2, 1
.set CYDEV_CHIP_REV_LEOPARD_ES3, 3
.set CYDEV_CHIP_REV_LEOPARD_PRODUCTION, 3
.set CYDEV_CHIP_REV_PSOC4A_ES0, 17
.set CYDEV_CHIP_REV_PSOC4A_PRODUCTION, 17
.set CYDEV_CHIP_REV_PSOC5LP_ES0, 0
.set CYDEV_CHIP_REV_PSOC5LP_PRODUCTION, 0
.set CYDEV_CHIP_REV_PSOC5TM_ES0, 0
.set CYDEV_CHIP_REV_PSOC5TM_ES1, 1
.set CYDEV_CHIP_REV_PSOC5TM_PRODUCTION, 1
.set CYDEV_CHIP_REV_TMA4_ES, 17
.set CYDEV_CHIP_REV_TMA4_ES2, 33
.set CYDEV_CHIP_REV_TMA4_PRODUCTION, 17
.set CYDEV_CHIP_REVISION_3A_ES1, 0
.set CYDEV_CHIP_REVISION_3A_ES2, 1
.set CYDEV_CHIP_REVISION_3A_ES3, 3
.set CYDEV_CHIP_REVISION_3A_PRODUCTION, 3
.set CYDEV_CHIP_REVISION_4A_ES0, 17
.set CYDEV_CHIP_REVISION_4A_PRODUCTION, 17
.set CYDEV_CHIP_REVISION_4D_PRODUCTION, 0
.set CYDEV_CHIP_REVISION_4E_CCG2_NO_USBPD, 0
.set CYDEV_CHIP_REVISION_4E_PRODUCTION, 0
.set CYDEV_CHIP_REVISION_4F_PRODUCTION, 0
.set CYDEV_CHIP_REVISION_4F_PRODUCTION_256DMA, 0
.set CYDEV_CHIP_REVISION_4F_PRODUCTION_256K, 0
.set CYDEV_CHIP_REVISION_4G_ES, 17
.set CYDEV_CHIP_REVISION_4G_ES2, 33
.set CYDEV_CHIP_REVISION_4G_PRODUCTION, 17
.set CYDEV_CHIP_REVISION_4H_PRODUCTION, 0
.set CYDEV_CHIP_REVISION_4I_PRODUCTION, 0
.set CYDEV_CHIP_REVISION_4J_PRODUCTION, 0
.set CYDEV_CHIP_REVISION_4K_PRODUCTION, 0
.set CYDEV_CHIP_REVISION_4L_PRODUCTION, 0
.set CYDEV_CHIP_REVISION_4M_PRODUCTION, 0
.set CYDEV_CHIP_REVISION_4N_PRODUCTION, 0
.set CYDEV_CHIP_REVISION_4O_PRODUCTION, 0
.set CYDEV_CHIP_REVISION_4P_PRODUCTION, 0
.set CYDEV_CHIP_REVISION_4Q_PRODUCTION, 0
.set CYDEV_CHIP_REVISION_4R_PRODUCTION, 0
.set CYDEV_CHIP_REVISION_4S_PRODUCTION, 0
.set CYDEV_CHIP_REVISION_4T_PRODUCTION, 0
.set CYDEV_CHIP_REVISION_4U_PRODUCTION, 0
.set CYDEV_CHIP_REVISION_4V_PRODUCTION, 0
.set CYDEV_CHIP_REVISION_5A_ES0, 0
.set CYDEV_CHIP_REVISION_5A_ES1, 1
.set CYDEV_CHIP_REVISION_5A_PRODUCTION, 1
.set CYDEV_CHIP_REVISION_5B_ES0, 0
.set CYDEV_CHIP_REVISION_5B_PRODUCTION, 0
.set CYDEV_CHIP_REVISION_6A_ES, 17
.set CYDEV_CHIP_REVISION_6A_NO_UDB, 33
.set CYDEV_CHIP_REVISION_6A_PRODUCTION, 33
.set CYDEV_CHIP_REVISION_FM3_PRODUCTION, 0
.set CYDEV_CHIP_REVISION_FM4_PRODUCTION, 0
.set CYDEV_CHIP_REVISION_PDL_FM0P_TYPE1_PRODUCTION, 0
.set CYDEV_CHIP_REVISION_PDL_FM0P_TYPE2_PRODUCTION, 0
.set CYDEV_CHIP_REVISION_PDL_FM0P_TYPE3_PRODUCTION, 0
.set CYDEV_CHIP_REVISION_USED, CYDEV_CHIP_REVISION_4M_PRODUCTION
.set CYDEV_CHIP_REV_EXPECT, CYDEV_CHIP_REVISION_USED
.set CYDEV_CONFIG_READ_ACCELERATOR, 1
.set CYDEV_CONFIG_UNUSED_IO_AllowButWarn, 0
.set CYDEV_CONFIG_UNUSED_IO_AllowWithInfo, 1
.set CYDEV_CONFIG_UNUSED_IO_Disallowed, 2
.set CYDEV_CONFIG_UNUSED_IO, CYDEV_CONFIG_UNUSED_IO_Disallowed
.set CYDEV_CONFIGURATION_COMPRESSED, 1
.set CYDEV_CONFIGURATION_MODE_COMPRESSED, 0
.set CYDEV_CONFIGURATION_MODE, CYDEV_CONFIGURATION_MODE_COMPRESSED
.set CYDEV_CONFIGURATION_MODE_DMA, 2
.set CYDEV_CONFIGURATION_MODE_UNCOMPRESSED, 1
.set CYDEV_DEBUG_PROTECT_KILL, 4
.set CYDEV_DEBUG_PROTECT_OPEN, 1
.set CYDEV_DEBUG_PROTECT, CYDEV_DEBUG_PROTECT_OPEN
.set CYDEV_DEBUG_PROTECT_PROTECTED, 2
.set CYDEV_DEBUGGING_DPS_Disable, 3
.set CYDEV_DEBUGGING_DPS_SWD, 2
.set CYDEV_DEBUGGING_DPS, CYDEV_DEBUGGING_DPS_SWD
.set CYDEV_DEBUGGING_ENABLE, 1
.set CYDEV_DFT_SELECT_CLK0, 10
.set CYDEV_DFT_SELECT_CLK1, 11
.set CYDEV_DMA_CHANNELS_AVAILABLE, 8
.set CYDEV_HEAP_SIZE, 0x80
.set CYDEV_IMO_TRIMMED_BY_USB, 0
.set CYDEV_IMO_TRIMMED_BY_WCO, 0
.set CYDEV_INTR_NUMBER_DMA, 13
.set CYDEV_IS_EXPORTING_CODE, 0
.set CYDEV_IS_IMPORTING_CODE, 0
.set CYDEV_PROJ_TYPE, 0
.set CYDEV_PROJ_TYPE_BOOTLOADER, 1
.set CYDEV_PROJ_TYPE_LAUNCHER, 5
.set CYDEV_PROJ_TYPE_LOADABLE, 2
.set CYDEV_PROJ_TYPE_LOADABLEANDBOOTLOADER, 4
.set CYDEV_PROJ_TYPE_MULTIAPPBOOTLOADER, 3
.set CYDEV_PROJ_TYPE_STANDARD, 0
.set CYDEV_STACK_SIZE, 0x0800
.set CYDEV_USE_BUNDLED_CMSIS, 1
.set CYDEV_VARIABLE_VDDA, 1
.set CYDEV_VDDA_MV, 3300
.set CYDEV_VDDD_MV, 3300
.set CYDEV_VDDIO_MV, 3300
.set CYDEV_WDT_GENERATE_ISR, 1
.set CYIPBLOCK_m0s8can_VERSION, 1
.set CYIPBLOCK_m0s8cpussv2_VERSION, 1
.set CYIPBLOCK_m0s8csd_VERSION, 1
.set CYIPBLOCK_m0s8ioss_VERSION, 1
.set CYIPBLOCK_m0s8lcd_VERSION, 2
.set CYIPBLOCK_m0s8lpcomp_VERSION, 2
.set CYIPBLOCK_m0s8peri_VERSION, 1
.set CYIPBLOCK_m0s8scb_VERSION, 2
.set CYIPBLOCK_m0s8srssv2_VERSION, 1
.set CYIPBLOCK_m0s8tcpwm_VERSION, 2
.set CYIPBLOCK_m0s8udbif_VERSION, 1
.set CYIPBLOCK_m0s8wco_VERSION, 1
.set CYIPBLOCK_s8pass4al_VERSION, 1
.set DMA_CHANNELS_USED__MASK, 0
.set CYDEV_BOOTLOADER_ENABLE, 0
.endif
